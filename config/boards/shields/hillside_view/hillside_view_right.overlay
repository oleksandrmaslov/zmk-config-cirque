/*
 * Copyright (c) 2022 The ZMK Contributors
 *
 * SPDX-License-Identifier: MIT
 */

#include "hillside_view.dtsi"
#include <input/processors.dtsi>
#include <dt-bindings/zmk/input_transform.h>
#include <behaviors/input_processor_gestures.dtsi>
#include <behaviors/input_processor_absolute_to_relative.dtsi>

&default_transform {
  col-offset = <6>;
};

&kscan0 {
  col-gpios
    = <&pro_micro 10 GPIO_ACTIVE_HIGH>
    , <&pro_micro 16 GPIO_ACTIVE_HIGH>
    , <&pro_micro 14 GPIO_ACTIVE_HIGH>
    , <&pro_micro 15 GPIO_ACTIVE_HIGH>
    , <&pro_micro 18 GPIO_ACTIVE_HIGH>
    , <&gpio1 7 GPIO_ACTIVE_HIGH>
    ;
};

&right_encoder {
  status = "disabled";
};

&chosen {
    zephyr,display-;
};



&i2c0 {
    status = "okay";
    glidepoint0: glidepoint@2a {
        status = "okay";
    };
};

/ {
    input_processors {
        scroll_scaler: zip_scroll_scaler {
            compatible = "zmk,input-processor-scaler";
            #input-processor-cells = <2>;
            type = <INPUT_EV_REL>;
            codes = <INPUT_REL_WHEEL>;
            track-remainders;
        };
    };
};

&zip_gestures {
    tap-detection;
    prevent_movement_during_tap;
    circular-scroll;
    circular-scroll-rim-percent=<15>;
};

/ {
  tpad0: tpad0 {
        compatible = "zmk,input-listener";
        device = <&glidepoint0>;
        input-processors = <
            &zip_gestures
            &zip_absolute_to_relative
            &zip_xy_transform (INPUT_TRANSFORM_XY_SWAP | INPUT_TRANSFORM_Y_INVERT)
            &zip_temp_layer 3 100
            &zip_scroll_scaler 1 10
        >;
        // xy-swap;
        // y-invert;
        // x-invert;
    };
};

 / {
      /* THIS only makes keymap binding happy, nothing happens on peripheral side */
	    glidepoint1: virtual_input {
  		compatible = "zmk,virtual-input";
  	};
//
//    input_relay_config_102 {
//        compatible = "zmk,split-peripheral-input-relay";
//
//        /* peripheral side input device, used to... */
//		/*  - be intecepted on peripheral; */
//		/*  - and then, be resurrected as `zmk,virtual-device` on central; */
//        device = <&glidepoint0>;
//
//        /* channel id, used to be be transfered along with all input events. */
//		/* NOTE 1: pick any 8bit integer. (1 - 255) */
//		/* NOTE 2: should matching relay-channel on central overlay */
//		relay-channel = <102>;
//    };
// };
