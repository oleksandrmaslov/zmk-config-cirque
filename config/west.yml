## config/west.yml
```yaml
manifest:
  remotes:
    - name: zmkfirmware
      url-base: https://github.com/zmkfirmware
    - name: badjeff
      url-base: https://github.com/badjeff
    - name: halfdane
      url-base: https://github.com/halfdane/
    - name: oleksandrmaslov
      url-base: https://github.com/oleksandrmaslov      
  projects:
    - name: zmk-pointing-acceleration
      remote: oleksandrmaslov
      revision: codex/fix-build-error-in-settings_reset-firmware
    - name: cirque-input-module
      remote: halfdane
      revision: main
    - name: zmk
      remote: zmkfirmware
      revision: main
      import: app/west.yml
    - name: zmk-behavior-insomnia
      remote: badjeff
      revision: main
    - name: zmk-kscan-blackout
      remote: badjeff
      revision: main      
  self:
    path: config
```
